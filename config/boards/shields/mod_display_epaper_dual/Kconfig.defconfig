## config/boards/shields/mod_display_epaper_dual/Kconfig.defconfig
```kconfig
# Copyright (c) 2026
# SPDX-License-Identifier: MIT

if SHIELD_MOD_DISPLAY_EPAPER_DUAL

config LV_Z_VDB_SIZE
    default 100

config LV_DPI_DEF
    default 130

config LV_Z_BITS_PER_PIXEL
    default 1

choice LV_COLOR_DEPTH
    default LV_COLOR_DEPTH_1
endchoice

choice ZMK_DISPLAY_WORK_QUEUE
    default ZMK_DISPLAY_WORK_QUEUE_DEDICATED
endchoice

choice ZMK_DISPLAY_STATUS_SCREEN
    default ZMK_DISPLAY_STATUS_SCREEN_CUSTOM
endchoice

config ZMK_DISPLAY
    select LV_USE_CONT

config HEAP_MEM_POOL_SIZE
    default 1024

config LV_Z_MEM_POOL_SIZE
    default 8192

config ZMK_DISPLAY_STATUS_SCREEN_CUSTOM
    imply HALCYON_EPAPER_WIDGET_DUAL

config HALCYON_EPAPER_WIDGET_DUAL
    bool "Custom Halcyon epaper status widget with dual battery display"
    select LV_FONT_MONTSERRAT_16
    select LV_FONT_MONTSERRAT_18
    select LV_FONT_MONTSERRAT_14
    select LV_FONT_UNSCII_8
    select LV_USE_IMAGE
    select LV_USE_CANVAS
    select ZMK_WPM

config HALCYON_EPAPER_DUAL_INVERTED
    bool "Invert custom status widget colors"

endif # SHIELD_MOD_DISPLAY_EPAPER_DUAL
```

## config/boards/shields/mod_display_epaper_dual/Kconfig.shield
```kconfig
# Copyright (c) 2026
# SPDX-License-Identifier: MIT

config SHIELD_MOD_DISPLAY_EPAPER_DUAL
    def_bool $(shields_list_contains,mod_display_epaper_dual)
```
